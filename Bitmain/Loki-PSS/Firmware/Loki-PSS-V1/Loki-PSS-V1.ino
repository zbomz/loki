#include <Wire.h>

//#define S17
//#define VERBOSE
#define I2C_PULLUPS

#define PSU_EN_READ_PIN                 P1_0
#define _PSU_LED_ON_PIN                 P2_6
#ifdef I2C_PULLUPS
  #define I2C_SCL_PULLUP_PIN            P2_3
  #define I2C_SDA_PULLUP_PIN            P2_4
#endif

#define PSU_ADDR                        0x10
#define I2C_RX_BUFFER_LEN               20
#define I2C_RESPONSE_BUFFER_LEN         8
#define I2C_LONG_RESPONSE_BUFFER_LEN    39
#define I2C_PACKET_HEADER_LEN           4
#define COMMAND_INDEX                   7
#define LUXOS_COMMAND_INDEX             4
#define NOT_LUX_OS_BYTE_VAL             0x11
#define VSET_INDEX                      9  
#define LUX_VSET_INDEX                  5

//PSU Voltage Message Preamble
const byte psu_voltage_msg_preamble[2] = {0xFE, 0xFF};

//APW121215a Responses
const byte a_h1_resp[I2C_RESPONSE_BUFFER_LEN] = {0x55, 0xAA, 0x06, 0x01, 0x10, 0x00, 0x17, 0x00};
const byte a_h2_resp[I2C_RESPONSE_BUFFER_LEN] = {0x55, 0xAA, 0x06, 0x02, 0x71, 0x00, 0x79, 0x00};

//APW121215e Responses
const byte e_h1_resp[I2C_RESPONSE_BUFFER_LEN] = {0x55, 0xAA, 0x06, 0x01, 0x16, 0x00, 0x1D, 0x00};
const byte e_h2_resp[I2C_RESPONSE_BUFFER_LEN] = {0x55, 0xAA, 0x06, 0x02, 0x75, 0x00, 0x7D, 0x00};
const byte h3_initialResp[I2C_RESPONSE_BUFFER_LEN] = {0x55, 0xAA, 0x06, 0x03, 0x00, 0x00, 0x09, 0x00}; 
const byte h4_initialResp[I2C_RESPONSE_BUFFER_LEN] = {0x55, 0xAA, 0x06, 0x04, 0x01, 0x00, 0x0B, 0x00};
const byte h6_resp[I2C_LONG_RESPONSE_BUFFER_LEN] = {
    0x55, 0xAA, 0x25, 0x06, 0x40, 0xFF, 0xFF, 0xFF, 0xFF, 0xFF, 0xFF, 0xFF, 0xFF, 0xFF, 
    0xFF, 0xFF, 0xFF, 0xFF, 0xFF, 0xFF, 0xFF, 0xFF, 0xFF, 0xFF, 0xFF, 0xFF, 0xFF, 0xFF, 
    0xFF, 0xFF, 0xFF, 0xFF, 0xFF, 0xFF, 0xFF, 0xFF, 0xFF, 0x4B, 0x20
  };
const byte hA_resp[I2C_RESPONSE_BUFFER_LEN] = {0x55, 0xAA, 0x06, 0x0A, 0x00, 0x00, 0x10, 0x00};
const byte h4_dynamicResp[256][4] = {
  {0xBD, 0x03, 0xCA, 0x00}, {0xBC, 0x03, 0xC9, 0x00}, {0xBB, 0x03, 0xC8, 0x00}, {0xBB, 0x03, 0xC8, 0x00}, 
  {0xBA, 0x03, 0xC7, 0x00}, {0xB9, 0x03, 0xC6, 0x00}, {0xB8, 0x03, 0xC5, 0x00}, {0xB7, 0x03, 0xC4, 0x00}, 
  {0xB7, 0x03, 0xC4, 0x00}, {0xB6, 0x03, 0xC3, 0x00}, {0xB5, 0x03, 0xC2, 0x00}, {0xB4, 0x03, 0xC1, 0x00}, 
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  {0xF5, 0x02, 0x01, 0x01}, {0xF4, 0x02, 0x00, 0x01}, {0xF3, 0x02, 0xFF, 0x00}, {0xF3, 0x02, 0xFF, 0x00} 
};

bool new_i2c_data_received = false;
bool new_i2c_data_requested = false;
bool spoofing_APW121215e = true;
bool h83_command_received = false;

byte set_voltage_code = 0x00;

byte i2c_read_buffer[I2C_RX_BUFFER_LEN];
int8_t  i2c_read_buffer_index = 0;

int8_t i2c_tx_response_index = 0;

void setup() {
  //Configure GPIO
  pinMode(PSU_EN_READ_PIN, INPUT_PULLUP);
  //attachInterrupt(digitalPinToInterrupt(PSU_EN_READ_PIN), psu_disabled_isr, RISING);
  
  pinMode(_PSU_LED_ON_PIN, OUTPUT);
  digitalWrite(_PSU_LED_ON_PIN, LOW);
  delay(100);
  digitalWrite(_PSU_LED_ON_PIN, HIGH);
  delay(100);
  digitalWrite(_PSU_LED_ON_PIN, LOW);
  delay(100);
  digitalWrite(_PSU_LED_ON_PIN, HIGH);
  
  #ifdef I2C_PULLUPS
    pinMode(I2C_SCL_PULLUP_PIN, INPUT_PULLUP);
    pinMode(I2C_SDA_PULLUP_PIN, INPUT_PULLUP);
  #endif

  //Detect if configured to spoof APW121215e (no config jumper) or APW121215a (P1_1 and P1_2 shorted with config jumper)
  pinMode(P1_2, INPUT);
  pinMode(P1_1, INPUT_PULLDOWN);
  bool P1_2_pulled_down = !digitalRead(P1_2);
  pinMode(P1_1, INPUT_PULLUP);
  bool P1_2_pulled_up = digitalRead(P1_2);
  if(P1_2_pulled_up && P1_2_pulled_down){ // |•-•|
    //Device configured for APW121215a
    spoofing_APW121215e = false;
  }
  else{ 
    //Default config. Device configured for APW121215e
    spoofing_APW121215e = true;
  }

  //Setup device as I2C slave
  Wire.setModule(0);            // map i2c functionality to module 0 pinset (1.6, 1.7)
  Wire.begin(PSU_ADDR);         // join i2c bus with address 48
  Wire.onRequest(requestEvent); // Function to run when data requested from master
  Wire.onReceive(receiveEvent); // Function to run when data received from master

  //Setup Serial comms with console
  Serial.begin(9600);           // start serial for output
#ifdef VERBOSE
  Serial.print("Loki online: ");
  Serial.write(set_voltage_code);
#endif
}

void loop() {
#ifdef VERBOSE
  if (new_i2c_data_received) {
    if (i2c_read_buffer[i2c_read_buffer_index - 1] == 0x00) {
      Serial.write(i2c_read_buffer, (i2c_read_buffer_index));
    }
    new_i2c_data_received = false;
  }
#endif

  //Turn on/off LED to indicate if PSU is enabled
  digitalWrite(_PSU_LED_ON_PIN, digitalRead(PSU_EN_READ_PIN));

  delay(50);
}

bool check_if_running_lux_os(){
  if(i2c_read_buffer[0] == i2c_read_buffer[2] && i2c_read_buffer[0] == i2c_read_buffer[4] && i2c_read_buffer[0] == i2c_read_buffer[6]) {
    return false;
  }
  else {
    return true;
  }
}

// *************************** ISRs *******************************

void psu_disabled_isr() {
  WDTCTL = 0;
}

void receiveEvent(int howMany)
{
  //flush i2c RX buffer if this is the first byte being received since last read
  if(i2c_read_buffer_index == 0) {
    for(int i = 0; i < I2C_RX_BUFFER_LEN; i++) {
      i2c_read_buffer[i] = 0xFF;
    }
  }
  while (Wire.available() && i2c_read_buffer_index < I2C_RX_BUFFER_LEN) {
    char c = Wire.read();
    i2c_read_buffer[i2c_read_buffer_index] = c;
    i2c_read_buffer_index++;
  #ifdef VERBOSE
    Serial.print(c);
  #endif
  }
  i2c_tx_response_index = 0;
  new_i2c_data_received = true;

  return;
}

void requestEvent()
{
  i2c_read_buffer_index = 0;
  bool send_psu_voltage_msg = false;

  if(check_if_running_lux_os()) {
    //Master is running LuxOS firmware. Tailor i2c response accordingly.
    uint8_t i = 0;
    switch(i2c_read_buffer[LUXOS_COMMAND_INDEX]){
      case 0x01:
        if(spoofing_APW121215e) {
          Wire.write(e_h1_resp, sizeof(e_h1_resp));  
        }
        else { 
          Wire.write(a_h1_resp, sizeof(a_h1_resp));
        }
        break;
      
      case 0x02:
        if(spoofing_APW121215e) { 
          Wire.write(e_h2_resp, sizeof(e_h2_resp)); 
        }
        else {
          Wire.write(a_h2_resp, sizeof(a_h2_resp));
        }
        break;
      
      case 0x03:
        if(h83_command_received) {
           //calculate checksum
           uint16_t cs = 0x06 + 0x03 + set_voltage_code;
           //construct response
           byte h3_resp[I2C_RESPONSE_BUFFER_LEN] = {
             0x55, 0xAA, 0x06, 0x03, set_voltage_code, 0x00, (cs & 0xFF), (cs >> 8)
           };
           Wire.write(h3_resp, sizeof(h3_resp));
        }
        else {
          Wire.write(h3_initialResp, sizeof(h3_initialResp));
        }
        break;
      
      case 0x04:
        //build proper response
        byte h4_resp[I2C_RESPONSE_BUFFER_LEN];
        for(i = 0; i < I2C_RESPONSE_BUFFER_LEN; i++) {
          h4_resp[i] = h4_initialResp[i];
        }
        if(h83_command_received) {
          for(i = 0; i < I2C_RESPONSE_BUFFER_LEN / 2; i++) {
             h4_resp[i + I2C_PACKET_HEADER_LEN] = h4_dynamicResp[set_voltage_code][i];
          }
        }
        Wire.write(h4_resp, sizeof(h4_resp));
        break; 
      
      case 0x06: 
        Wire.write(h6_resp, sizeof(h6_resp)); 
        break;
      
      case 0x0A: 
        Wire.write(hA_resp, sizeof(hA_resp)); 
        break;

      case 0x81:
        byte h81_resp[I2C_RESPONSE_BUFFER_LEN];
        for(i = 0; i < I2C_RESPONSE_BUFFER_LEN; i++) {
          h81_resp[i] = i2c_read_buffer[(i + 1)];
        }
        Wire.write(h81_resp, sizeof(h81_resp));
        break;
      
      case 0x83:
        h83_command_received = true;
        set_voltage_code = i2c_read_buffer[LUX_VSET_INDEX];
        byte h83_resp[I2C_RESPONSE_BUFFER_LEN];  
        for(i = 0; i < I2C_RESPONSE_BUFFER_LEN; i++) {
          h83_resp[i] = i2c_read_buffer[(i + 1)];
        }
        Wire.write(h83_resp, sizeof(h83_resp));
        Serial.write(set_voltage_code);
        break;

      default:
        Wire.write(0xF5);
    }
  }
  else {
    //Master is not running LuxOS firmware. Tailor i2c response accordingly.

    byte b;
    switch(i2c_read_buffer[COMMAND_INDEX]) {
      case 0x01:
        if(spoofing_APW121215e) {
          b = e_h1_resp[i2c_tx_response_index];
        }
        else { 
          b = a_h1_resp[i2c_tx_response_index];
        }
        break;
      
      case 0x02:
        if(spoofing_APW121215e) {  
          b = e_h2_resp[i2c_tx_response_index]; 
        }
        else {
          b = a_h2_resp[i2c_tx_response_index];
        }
        break;
          
      case 0x03:  
        b = h3_initialResp[i2c_tx_response_index]; 
        break;
        
      case 0x04:  
        if(h83_command_received){
          if(i2c_tx_response_index < 4) {
            b = h4_initialResp[i2c_tx_response_index];
          }
          else {
            b = h4_dynamicResp[set_voltage_code][i2c_tx_response_index - 4];
          }
        }
        else{
          b = h4_initialResp[i2c_tx_response_index];
        }
        break;

      case 0x06:
        b = h6_resp[i2c_tx_response_index]; 
        break;

      case 0x0A:
        b = hA_resp[i2c_tx_response_index]; 
        break;

      case 0x81:
        b = i2c_read_buffer[(i2c_tx_response_index * 2 + 1)];
        break;

      case 0x83:
        h83_command_received = true;
        set_voltage_code = i2c_read_buffer[VSET_INDEX];
        b = i2c_read_buffer[(i2c_tx_response_index * 2 + 1)];
        if(i2c_tx_response_index == 0) {
           send_psu_voltage_msg = true;       
        }
        break;
      
      default:
        b = 0xF5;  
    }
    Wire.write(b);
    if(send_psu_voltage_msg) {
      Serial.write(set_voltage_code);
    }
    
    i2c_tx_response_index++;
  }
    
  return;    
}
